 / {
    macros {
        zoom_in: zoom_in {
            compatible = "zmk,behavior-macro";
            label = "ZOOM_IN";
            bindings = <
                &macro_press &kp LEFT_CONTROL
                &macro_tap &msc SCRL_UP
                &macro_release &kp LEFT_CONTROL
            >;
        };

        zoom_out: zoom_out {
            compatible = "zmk,behavior-macro";
            label = "ZOOM_OUT";
            bindings = <
                &macro_press &kp LEFT_CONTROL
                &macro_tap &msc SCRL_DOWN
                &macro_release &kp LEFT_CONTROL
            >;
        };
    };
};
